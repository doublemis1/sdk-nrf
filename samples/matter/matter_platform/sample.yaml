## samples/matter/matter_platform/sample.yaml
```yaml
sample:
  description: Matter Platform example
  name: Matter Platform
tests:
  sample.matter.matter_platform.debug:
    sysbuild: true
    build_only: true
    integration_platforms:
      - nrf7002dk/nrf5340/cpuapp
      - nrf54l15dk/nrf54l15/cpuapp
    platform_allow:
      - nrf7002dk/nrf5340/cpuapp
      - nrf54l15dk/nrf54l15/cpuapp
    tags:
      - sysbuild
      - ci_samples_matter
```

## samples/matter/smoke_co_alarm/sample.yaml
```yaml
sample:
  description: Matter Smoke CO Alarm example
  name: Matter Smoke CO Alarm
common:
  tags:
    - sysbuild
    - ci_samples_matter
tests:
  sample.matter.smoke_co_alarm.debug:
    sysbuild: true
    build_only: true
    integration_platforms:
      - nrf52840dk/nrf52840
      - nrf5340dk/nrf5340/cpuapp
      - nrf54l15dk/nrf54l15/cpuapp
      - nrf54l15dk/nrf54l10/cpuapp
      - nrf54lm20dk/nrf54lm20a/cpuapp
    platform_allow:
      - nrf52840dk/nrf52840
      - nrf5340dk/nrf5340/cpuapp
      - nrf54l15dk/nrf54l15/cpuapp
      - nrf54l15dk/nrf54l10/cpuapp
      - nrf54lm20dk/nrf54lm20a/cpuapp
  sample.matter.smoke_co_alarm.release:
    sysbuild: true
    build_only: true
    extra_args:
      - FILE_SUFFIX=release
      - SB_CONFIG_BOOTLOADER_MCUBOOT=y
      - SB_CONFIG_PARTITION_MANAGER=y
    integration_platforms:
      - nrf52840dk/nrf52840
      - nrf5340dk/nrf5340/cpuapp
      - nrf54l15dk/nrf54l15/cpuapp
      - nrf54l15dk/nrf54l10/cpuapp
      - nrf54lm20dk/nrf54lm20a/cpuapp
    platform_allow:
      - nrf52840dk/nrf52840
      - nrf5340dk/nrf5340/cpuapp
      - nrf54l15dk/nrf54l15/cpuapp
      - nrf54l15dk/nrf54l10/cpuapp
      - nrf54lm20dk/nrf54lm20a/cpuapp
  sample.matter.smoke_co_alarm.release.power_consumption:
    sysbuild: true
    build_only: true
    extra_args:
      - FILE_SUFFIX=release
      - CONFIG_NCS_SAMPLE_MATTER_LEDS=n
      - CONFIG_NCS_SAMPLE_MATTER_WATCHDOG=n
      - CONFIG_CHIP_ENABLE_PAIRING_AUTOSTART=y
    integration_platforms:
      - nrf52840dk/nrf52840
      - nrf5340dk/nrf5340/cpuapp
      - nrf54l15dk/nrf54l15/cpuapp
      - nrf54lm20dk/nrf54lm20a/cpuapp
    platform_allow:
      - nrf52840dk/nrf52840
      - nrf5340dk/nrf5340/cpuapp
      - nrf54l15dk/nrf54l15/cpuapp
      - nrf54lm20dk/nrf54lm20a/cpuapp

  sample.matter.smoke_co_alarm.release.power_consumption.tool_8:
    sysbuild: true
    build_only: true
    extra_args:
      - FILE_SUFFIX=release
      - CONFIG_NCS_SAMPLE_MATTER_LEDS=n
      - CONFIG_NCS_SAMPLE_MATTER_WATCHDOG=n
      - CONFIG_CHIP_ENABLE_PAIRING_AUTOSTART=y
      - CONFIG_OPENTHREAD_DEFAULT_TX_POWER=8
    integration_platforms:
      - nrf52840dk/nrf52840
      - nrf5340dk/nrf5340/cpuapp
      - nrf54l15dk/nrf54l15/cpuapp
      - nrf54lm20dk/nrf54lm20a/cpuapp
    platform_allow:
      - nrf52840dk/nrf52840
      - nrf5340dk/nrf5340/cpuapp
      - nrf54l15dk/nrf54l15/cpuapp
      - nrf54lm20dk/nrf54lm20a/cpuapp

  sample.matter.smoke_co_alarm.release.power_consumption.tool_0:
    sysbuild: true
    build_only: true
    extra_args:
      - FILE_SUFFIX=release
      - CONFIG_NCS_SAMPLE_MATTER_LEDS=n
      - CONFIG_NCS_SAMPLE_MATTER_WATCHDOG=n
      - CONFIG_CHIP_ENABLE_PAIRING_AUTOSTART=y
      - CONFIG_OPENTHREAD_DEFAULT_TX_POWER=0
    integration_platforms:
      - nrf52840dk/nrf52840
      - nrf5340dk/nrf5340/cpuapp
      - nrf54l15dk/nrf54l15/cpuapp
      - nrf54lm20dk/nrf54lm20a/cpuapp
    platform_allow:
      - nrf52840dk/nrf52840
      - nrf5340dk/nrf5340/cpuapp
      - nrf54l15dk/nrf54l15/cpuapp
      - nrf54lm20dk/nrf54lm20a/cpuapp

  sample.matter.smoke_co_alarm.release.power_consumption.whitepaper_1:
    sysbuild: true
    build_only: true
    extra_args:
      - FILE_SUFFIX=release
      - CONFIG_NCS_SAMPLE_MATTER_LEDS=n
      - CONFIG_NCS_SAMPLE_MATTER_WATCHDOG=n
      - CONFIG_CHIP_ENABLE_PAIRING_AUTOSTART=y
      - CONFIG_CHIP_ICD_SLOW_POLL_INTERVAL=120000
      - CONFIG_CHIP_ICD_FAST_POLLING_INTERVAL=200
      - CONFIG_CHIP_ICD_IDLE_MODE_DURATION=120
      - CONFIG_CHIP_ICD_ACTIVE_MODE_DURATION=300
      - CONFIG_CHIP_ICD_ACTIVE_MODE_THRESHOLD=5000
    integration_platforms:
      - nrf52840dk/nrf52840
      - nrf5340dk/nrf5340/cpuapp
      - nrf54l15dk/nrf54l15/cpuapp
      - nrf54lm20dk/nrf54lm20a/cpuapp
    platform_allow:
      - nrf52840dk/nrf52840
      - nrf5340dk/nrf5340/cpuapp
      - nrf54l15dk/nrf54l15/cpuapp
      - nrf54lm20dk/nrf54lm20a/cpuapp

  sample.matter.smoke_co_alarm.release.power_consumption.whitepaper_2:
    sysbuild: true
    build_only: true
    extra_args:
      - FILE_SUFFIX=release
      - CONFIG_NCS_SAMPLE_MATTER_LEDS=n
      - CONFIG_NCS_SAMPLE_MATTER_WATCHDOG=n
      - CONFIG_CHIP_ENABLE_PAIRING_AUTOSTART=y
      - CONFIG_CHIP_ICD_SLOW_POLL_INTERVAL=120000
      - CONFIG_CHIP_ICD_FAST_POLLING_INTERVAL=500
      - CONFIG_CHIP_ICD_IDLE_MODE_DURATION=120
      - CONFIG_CHIP_ICD_ACTIVE_MODE_DURATION=300
      - CONFIG_CHIP_ICD_ACTIVE_MODE_THRESHOLD=5000
    integration_platforms:
      - nrf52840dk/nrf52840
      - nrf5340dk/nrf5340/cpuapp
      - nrf54l15dk/nrf54l15/cpuapp
      - nrf54lm20dk/nrf54lm20a/cpuapp
    platform_allow:
      - nrf52840dk/nrf52840
      - nrf5340dk/nrf5340/cpuapp
      - nrf54l15dk/nrf54l15/cpuapp
      - nrf54lm20dk/nrf54lm20a/cpuapp

  sample.matter.smoke_co_alarm.release.power_consumption.whitepaper_3:
    sysbuild: true
    build_only: true
    extra_args:
      - FILE_SUFFIX=release
      - CONFIG_NCS_SAMPLE_MATTER_LEDS=n
      - CONFIG_NCS_SAMPLE_MATTER_WATCHDOG=n
      - CONFIG_CHIP_ENABLE_PAIRING_AUTOSTART=y
      - CONFIG_CHIP_ICD_SLOW_POLL_INTERVAL=900000
      - CONFIG_CHIP_ICD_FAST_POLLING_INTERVAL=200
      - CONFIG_CHIP_ICD_IDLE_MODE_DURATION=900
      - CONFIG_CHIP_ICD_ACTIVE_MODE_DURATION=300
      - CONFIG_CHIP_ICD_ACTIVE_MODE_THRESHOLD=5000
    integration_platforms:
      - nrf52840dk/nrf52840
      - nrf5340dk/nrf5340/cpuapp
      - nrf54l15dk/nrf54l15/cpuapp
      - nrf54lm20dk/nrf54lm20a/cpuapp
    platform_allow:
      - nrf52840dk/nrf52840
      - nrf5340dk/nrf5340/cpuapp
      - nrf54l15dk/nrf54l15/cpuapp
      - nrf54lm20dk/nrf54lm20a/cpuapp
```
