## Kconfig
```
#
# Copyright (c) 2021 Nordic Semiconductor
#
# SPDX-License-Identifier: LicenseRef-Nordic-5-Clause
#

mainmenu "Matter Lock sample application"

config LOCK_MAX_NUM_USERS
	int "Maximum number of users supported by the lock"
	default 10

config LOCK_MAX_NUM_CREDENTIALS_PER_USER
	int "Maximum total number of credentials per one user supported by the lock"
	default 4

config LOCK_MAX_NUM_CREDENTIALS_PER_TYPE
	int "Maximum number of credentials of given type supported by the lock"
	default 15

config LOCK_MAX_CREDENTIAL_LENGTH
	int "Maximum length of the single credential supported by the lock"
	default 65 # it corresponds with the DOOR_LOCK_ALIRO_CREDENTIAL_SIZE

config LOCK_SCHEDULES
	bool "Support for WeekDay, YearDay and Holiday schedules in lock"
	help
	  This option adds support for an optional Timed Schedule Access Lock feature.
	  You can use Week Day, Year Day and Holiday schedules to restrict access for a
	  specific user for a defined time window. For example, use it to
	  give the user access only for three days in week.

if LOCK_SCHEDULES

config LOCK_MAX_WEEKDAY_SCHEDULES_PER_USER
	int "Maximum number of WeekDay schedules per one user supported by the lock"
	default 5

config LOCK_MAX_YEARDAY_SCHEDULES_PER_USER
	int "Maximum number of YearDay schedules per one user supported by the lock"
	default 5

config LOCK_MAX_HOLIDAY_SCHEDULES
	int "Maximum number of Holiday schedules supported by the lock"
	default 5

endif

config LOCK_ENABLE_DEBUG
	bool "Enable debug features to print users and credentials"
	depends on SHELL
	help
	  Debug features allows to checking and printing current users, their state, and
	  associated credentials. Use these with shell commands combinations to read saved credentials
	  or users, and manage them (add, clear, read).

if LOCK_ENABLE_DEBUG

config LOCK_PRINT_STORAGE_STATUS
	bool "Print storage status after each store call"
	help
	  Debug feature to print the debug-level log that contains information of the entry being stored
	  to persistent storage and how many bytes are left to store the new entry. It can be used to verify
	  whether credential, schedule or user entries are written properly to persistent storage.
	  This option should be disabled in production firmware
	  version.

# This should be deterined based on the maximum possible command length that depends on the LOCK_MAX_CREDENTIAL_LENGTH
config SHELL_CMD_BUFF_SIZE
	default 300

endif

config LOCK_LEAVE_FABRIC_CLEAR_CREDENTIAL
	bool "Clear all credentials assigned to given fabric index"
	default y
	help
	  This feature allows to remove all credentials which were created or modified
	  within the fabric which is being removed from the door lock.

config STATE_LEDS
	bool "Use LEDs to indicate the device state"
	default y
	help
	  Use LEDs to render the current state of the device such as the progress of commissioning of
	  the device into a network or the factory reset initiation. Note that setting this option to
	  'n' does not disable the LED indicating the state of the simulated bolt.

config THREAD_WIFI_SWITCHING
	bool "Switching between Thread and Wi-Fi"
	depends on SOC_SERIES_NRF53X
	depends on NET_L2_OPENTHREAD
	depends on CHIP_WIFI
	depends on !CHIP_FACTORY_RESET_ERASE_NVS
	select EXPERIMENTAL
	help
	  Build the application with both Thread and Wi-Fi support and initialize
	  either transport based on the current configuration. A user can switch
	  between Thread and Wi-Fi by pressing and holding Button 3 for more than
	  10 seconds. During the switching, the device is automatically factory
	  reset and rebooted.

if THREAD_WIFI_SWITCHING

config THREAD_WIFI_SWITCHING_SHELL
	bool "Shell command for switching between Thread and Wi-Fi"
	default y if SHELL
	help
	  Add "switch_transport" shell command that initiates switching between
	  Thread and Wi-Fi transport for Matter protocol stack.

endif # THREAD_WIFI_SWITCHING

# Sample configuration used for Thread networking
if NET_L2_OPENTHREAD

choice OPENTHREAD_NORDIC_LIBRARY_CONFIGURATION
	default OPENTHREAD_NORDIC_LIBRARY_MTD
endchoice

choice OPENTHREAD_DEVICE_TYPE
	default OPENTHREAD_MTD
endchoice

config CHIP_ENABLE_ICD_SUPPORT
	default y

# Reduce Thread TX output power to 0 dBm for SED device
config OPENTHREAD_DEFAULT_TX_POWER
	int
	default 0

endif # NET_L2_OPENTHREAD

if CHIP_WIFI

config NRF_WIFI_LOW_POWER
	default y

endif # CHIP_WIFI

config NCS_SAMPLE_MATTER_PERSISTENT_STORAGE
	default y

config NCS_SAMPLE_MATTER_SECURE_STORAGE_BACKEND
	default y if !CHIP_WIFI

config NCS_SAMPLE_MATTER_SETTINGS_STORAGE_BACKEND
	default n if !CHIP_WIFI

# Increase the storage capacity if the schedules are enabled with secure storage.
# This also implies increasing of the OT and Matter stacks (the latter is tuned in chip_project_config.h)
# because some operations performed during commissioning seem to allocate stack buffers based on the
# maximum possible secure asset size.
if LOCK_SCHEDULES && NCS_SAMPLE_MATTER_SECURE_STORAGE_BACKEND

config NCS_SAMPLE_MATTER_SECURE_STORAGE_MAX_ENTRY_NUMBER
	default 128

config TRUSTED_STORAGE_BACKEND_AEAD_MAX_DATA_SIZE
	default 3072

config OPENTHREAD_THREAD_STACK_SIZE
	default 5120
endif

source "${ZEPHYR_CONNECTEDHOMEIP_MODULE_DIR}/config/nrfconnect/chip-module/Kconfig.features"
source "${ZEPHYR_CONNECTEDHOMEIP_MODULE_DIR}/config/nrfconnect/chip-module/Kconfig.defaults"
source "${ZEPHYR_NRF_MODULE_DIR}/samples/matter/common/src/Kconfig"
source "Kconfig.zephyr"
```

## sample.yaml
```
sample:
  description: Matter Lock example
  name: Matter Lock
common:
  tags:
    - sysbuild
    - ci_samples_matter
tests:
  sample.matter.lock.debug:
    sysbuild: true
    build_only: true
    integration_platforms:
      - nrf52840dk/nrf52840
      - nrf5340dk/nrf5340/cpuapp
      - nrf7002dk/nrf5340/cpuapp
      - nrf7002dk/nrf5340/cpuapp/nrf7001
      - nrf54l15dk/nrf54l15/cpuapp
      - nrf54l15dk/nrf54l15/cpuapp/ns
      - nrf54lm20dk/nrf54lm20a/cpuapp
    platform_allow:
      - nrf52840dk/nrf52840
      - nrf5340dk/nrf5340/cpuapp
      - nrf7002dk/nrf5340/cpuapp
      - nrf7002dk/nrf5340/cpuapp/nrf7001
      - nrf54l15dk/nrf54l15/cpuapp
      - nrf54l15dk/nrf54l15/cpuapp/ns
      - nrf54lm20dk/nrf54lm20a/cpuapp
  sample.matter.lock.nrf7002eb2.debug:
    sysbuild: true
    build_only: true
    extra_args:
      - lock_SHIELD=nrf7002eb2
      - SB_CONFIG_WIFI_NRF70=y
    integration_platforms:
      - nrf54lm20dk/nrf54lm20a/cpuapp
    platform_allow:
      - nrf54lm20dk/nrf54lm20a/cpuapp
  sample.matter.lock.release:
    sysbuild: true
    build_only: true
    extra_args:
      - FILE_SUFFIX=release
    integration_platforms:
      - nrf52840dk/nrf52840
      - nrf5340dk/nrf5340/cpuapp
      - nrf7002dk/nrf5340/cpuapp
      - nrf7002dk/nrf5340/cpuapp/nrf7001
      - nrf54l15dk/nrf54l15/cpuapp
      - nrf54lm20dk/nrf54lm20a/cpuapp
    platform_allow:
      - nrf52840dk/nrf52840
      - nrf5340dk/nrf5340/cpuapp
      - nrf7002dk/nrf5340/cpuapp
      - nrf7002dk/nrf5340/cpuapp/nrf7001
      - nrf54l15dk/nrf54l15/cpuapp
      - nrf54lm20dk/nrf54lm20a/cpuapp
  sample.matter.lock.nrf7002eb2.release:
    sysbuild: true
    build_only: true
    extra_args:
      - FILE_SUFFIX=release
      - SB_CONFIG_BOOTLOADER_MCUBOOT=y
      - SB_CONFIG_PARTITION_MANAGER=y
      - lock_SHIELD=nrf7002eb2
      - SB_CONFIG_WIFI_NRF70=y
    integration_platforms:
      - nrf54lm20dk/nrf54lm20a/cpuapp
    platform_allow:
      - nrf54lm20dk/nrf54lm20a/cpuapp
  sample.matter.lock.smp_dfu:
    sysbuild: true
    build_only: true
    extra_args:
      - CONFIG_CHIP_DFU_OVER_BT_SMP=y
    integration_platforms:
      - nrf52840dk/nrf52840
      - nrf5340dk/nrf5340/cpuapp
      - nrf7002dk/nrf5340/cpuapp
      - nrf7002dk/nrf5340/cpuapp/nrf7001
      - nrf54l15dk/nrf54l15/cpuapp
      - nrf54lm20dk/nrf54lm20a/cpuapp
    platform_allow:
      - nrf52840dk/nrf52840
      - nrf5340dk/nrf5340/cpuapp
      - nrf7002dk/nrf5340/cpuapp
      - nrf7002dk/nrf5340/cpuapp/nrf7001
      - nrf54l15dk/nrf54l15/cpuapp
      - nrf54lm20dk/nrf54lm20a/cpuapp
  sample.matter.lock.nrf7002eb2.smp_dfu:
    sysbuild: true
    build_only: true
    extra_args:
      - CONFIG_CHIP_DFU_OVER_BT_SMP=y
      - lock_SHIELD=nrf7002eb2
      - SB_CONFIG_WIFI_NRF70=y
    integration_platforms:
      - nrf54lm20dk/nrf54lm20a/cpuapp
    platform_allow:
      - nrf54lm20dk/nrf54lm20a/cpuapp
  sample.matter.lock.no_dfu.no_fd:
    sysbuild: true
    build_only: true
    extra_args:
      - SB_CONFIG_MATTER_OTA=n
    integration_platforms:
      - nrf21540dk/nrf52840
    platform_allow: nrf21540dk/nrf52840
  sample.matter.lock.thread_wifi_switched.smp_dfu:
    sysbuild: true
    build_only: true
    extra_args:
      - lock_SHIELD=nrf7002ek
      - FILE_SUFFIX=thread_wifi_switched
      - SB_CONFIG_WIFI_PATCHES_EXT_FLASH_STORE=y
      - SB_CONFIG_MCUBOOT_UPDATEABLE_IMAGES=3
      - CONFIG_CHIP_DFU_OVER_BT_SMP=y
      - SB_CONFIG_WIFI_NRF70=y
      - SB_CONFIG_DFU_MULTI_IMAGE_PACKAGE_WIFI_FW_PATCH=y
    integration_platforms:
      - nrf5340dk/nrf5340/cpuapp
    platform_allow: nrf5340dk/nrf5340/cpuapp
  sample.matter.lock.nus:
    sysbuild: true
    build_only: true
    extra_args:
      - CONFIG_CHIP_NUS=y
      - CONFIG_BT_APP_PASSKEY=y
      - CONFIG_CHIP_NUS_FIXED_PASSKEY=112233
    integration_platforms:
      - nrf52840dk/nrf52840
      - nrf5340dk/nrf5340/cpuapp
    platform_allow:
      - nrf52840dk/nrf52840
      - nrf5340dk/nrf5340/cpuapp
      - nrf54l15dk/nrf54l15/cpuapp
  sample.matter.lock.schedules:
    sysbuild: true
    build_only: true
    extra_args:
      - lock_SNIPPET=schedules
    integration_platforms:
      - nrf5340dk/nrf5340/cpuapp
    platform_allow:
      - nrf5340dk/nrf5340/cpuapp
  sample.matter.lock.release.power_consumption:
    sysbuild: true
    build_only: true
    extra_args:
      - FILE_SUFFIX=release
      - CONFIG_NCS_SAMPLE_MATTER_LEDS=n
      - CONFIG_NCS_SAMPLE_MATTER_WATCHDOG=n
      - CONFIG_CHIP_ENABLE_PAIRING_AUTOSTART=y
    integration_platforms:
      - nrf52840dk/nrf52840
      - nrf5340dk/nrf5340/cpuapp
      - nrf54l15dk/nrf54l15/cpuapp
      - nrf54lm20dk/nrf54lm20a/cpuapp
    platform_allow:
      - nrf52840dk/nrf52840
      - nrf5340dk/nrf5340/cpuapp
      - nrf54l15dk/nrf54l15/cpuapp
      - nrf54lm20dk/nrf54lm20a/cpuapp

  sample.matter.lock.release.power_consumption.tool_8:
    sysbuild: true
    build_only: true
    extra_args:
      - FILE_SUFFIX=release
      - CONFIG_NCS_SAMPLE_MATTER_LEDS=n
      - CONFIG_NCS_SAMPLE_MATTER_WATCHDOG=n
      - CONFIG_CHIP_ENABLE_PAIRING_AUTOSTART=y
      - CONFIG_OPENTHREAD_DEFAULT_TX_POWER=8
    integration_platforms:
      - nrf52840dk/nrf52840
      - nrf5340dk/nrf5340/cpuapp
      - nrf54l15dk/nrf54l15/cpuapp
      - nrf54lm20dk/nrf54lm20a/cpuapp
    platform_allow:
      - nrf52840dk/nrf52840
      - nrf5340dk/nrf5340/cpuapp
      - nrf54l15dk/nrf54l15/cpuapp
      - nrf54lm20dk/nrf54lm20a/cpuapp

  sample.matter.lock.release.power_consumption.tool_0:
    sysbuild: true
    build_only: true
    extra_args:
      - FILE_SUFFIX=release
      - CONFIG_NCS_SAMPLE_MATTER_LEDS=n
      - CONFIG_NCS_SAMPLE_MATTER_WATCHDOG=n
      - CONFIG_CHIP_ENABLE_PAIRING_AUTOSTART=y
      - CONFIG_OPENTHREAD_DEFAULT_TX_POWER=0
    integration_platforms:
      - nrf52840dk/nrf52840
      - nrf5340dk/nrf5340/cpuapp
      - nrf54l15dk/nrf54l15/cpuapp
      - nrf54lm20dk/nrf54lm20a/cpuapp
    platform_allow:
      - nrf52840dk/nrf52840
      - nrf5340dk/nrf5340/cpuapp
      - nrf54l15dk/nrf54l15/cpuapp
      - nrf54lm20dk/nrf54lm20a/cpuapp

  sample.matter.lock.release.power_consumption.whitepaper_1:
    sysbuild: true
    build_only: true
    extra_args:
      - FILE_SUFFIX=release
      - CONFIG_NCS_SAMPLE_MATTER_LEDS=n
      - CONFIG_NCS_SAMPLE_MATTER_WATCHDOG=n
      - CONFIG_CHIP_ENABLE_PAIRING_AUTOSTART=y
      - CONFIG_CHIP_ICD_SLOW_POLL_INTERVAL=1000
      - CONFIG_CHIP_ICD_FAST_POLLING_INTERVAL=200
      - CONFIG_CHIP_ICD_IDLE_MODE_DURATION=120
      - CONFIG_CHIP_ICD_ACTIVE_MODE_DURATION=300
      - CONFIG_CHIP_ICD_ACTIVE_MODE_THRESHOLD=300
    integration_platforms:
      - nrf52840dk/nrf52840
      - nrf5340dk/nrf5340/cpuapp
      - nrf54l15dk/nrf54l15/cpuapp
      - nrf54lm20dk/nrf54lm20a/cpuapp
    platform_allow:
      - nrf52840dk/nrf52840
      - nrf5340dk/nrf5340/cpuapp
      - nrf54l15dk/nrf54l15/cpuapp
      - nrf54lm20dk/nrf54lm20a/cpuapp

  sample.matter.lock.release.power_consumption.whitepaper_2:
    sysbuild: true
    build_only: true
    extra_args:
      - FILE_SUFFIX=release
      - CONFIG_NCS_SAMPLE_MATTER_LEDS=n
      - CONFIG_NCS_SAMPLE_MATTER_WATCHDOG=n
      - CONFIG_CHIP_ENABLE_PAIRING_AUTOSTART=y
      - CONFIG_CHIP_ICD_SLOW_POLL_INTERVAL=2500
      - CONFIG_CHIP_ICD_FAST_POLLING_INTERVAL=200
      - CONFIG_CHIP_ICD_IDLE_MODE_DURATION=120
      - CONFIG_CHIP_ICD_ACTIVE_MODE_DURATION=300
      - CONFIG_CHIP_ICD_ACTIVE_MODE_THRESHOLD=300
    integration_platforms:
      - nrf52840dk/nrf52840
      - nrf5340dk/nrf5340/cpuapp
      - nrf54l15dk/nrf54l15/cpuapp
      - nrf54lm20dk/nrf54lm20a/cpuapp
    platform_allow:
      - nrf52840dk/nrf52840
      - nrf5340dk/nrf5340/cpuapp
      - nrf54l15dk/nrf54l15/cpuapp
      - nrf54lm20dk/nrf54lm20a/cpuapp

  sample.matter.lock.release.power_consumption.whitepaper_3:
    sysbuild: true
    build_only: true
    extra_args:
      - FILE_SUFFIX=release
      - CONFIG_NCS_SAMPLE_MATTER_LEDS=n
      - CONFIG_NCS_SAMPLE_MATTER_WATCHDOG=n
      - CONFIG_CHIP_ENABLE_PAIRING_AUTOSTART=y
      - CONFIG_CHIP_ICD_SLOW_POLL_INTERVAL=5000
      - CONFIG_CHIP_ICD_FAST_POLLING_INTERVAL=200
      - CONFIG_CHIP_ICD_IDLE_MODE_DURATION=300
      - CONFIG_CHIP_ICD_ACTIVE_MODE_DURATION=300
      - CONFIG_CHIP_ICD_ACTIVE_MODE_THRESHOLD=300
    integration_platforms:
      - nrf52840dk/nrf52840
      - nrf5340dk/nrf5340/cpuapp
      - nrf54l15dk/nrf54l15/cpuapp
      - nrf54lm20dk/nrf54lm20a/cpuapp
    platform_allow:
      - nrf52840dk/nrf52840
      - nrf5340dk/nrf5340/cpuapp
      - nrf54l15dk/nrf54l15/cpuapp
      - nrf54lm20dk/nrf54lm20a/cpuapp
```

## prj.conf
```kconfig
#
# Copyright (c) 2022 Nordic Semiconductor ASA
#
# SPDX-License-Identifier: LicenseRef-Nordic-5-Clause
#

# This sample uses Kconfig.defaults to set options common for all
# samples. This file should contain only options specific for this sample
# or overrides of default values.

# Enable CHIP
CONFIG_CHIP=y
CONFIG_CHIP_PROJECT_CONFIG="src/chip_project_config.h"
# 32774 == 0x8006 (example lock-app)
CONFIG_CHIP_DEVICE_PRODUCT_ID=32774
CONFIG_STD_CPP17=y

# Enable Matter extended announcement and increase duration to 1 hour.
CONFIG_CHIP_BLE_EXT_ADVERTISING=y
CONFIG_CHIP_BLE_ADVERTISING_DURATION=60

# Add support for LEDs and buttons on Nordic development kits
CONFIG_DK_LIBRARY=y

# Bluetooth Low Energy configuration
CONFIG_BT_DEVICE_NAME="MatterLock"

# Suspend devices when the CPU goes into sleep
CONFIG_PM_DEVICE=y

# Other settings
CONFIG_THREAD_NAME=y
CONFIG_MPU_STACK_GUARD=y
CONFIG_RESET_ON_FATAL_ERROR=n
CONFIG_CHIP_LIB_SHELL=y

# Reduce application size
CONFIG_USE_SEGGER_RTT=n
CONFIG_MATTER_LOG_LEVEL_INF=y
CONFIG_CHIP_APP_LOG_LEVEL=3

# Enable Factory Data feature
CONFIG_CHIP_FACTORY_DATA=y
CONFIG_CHIP_FACTORY_DATA_BUILD=y


# WIFI
CONFIG_NET_BUF_VARIABLE_DATA_SIZE=y
```

## overlay-factory_data_build_1.conf
```kconfig
#
# Copyright (c) 2023 Nordic Semiconductor ASA
#
# SPDX-License-Identifier: LicenseRef-Nordic-5-Clause
#

# Use this overlay to re-generate new PAI and DAC certificates.
# Be sure that chip-cert executable is added to your system PATH.

# Enable building the new factory data
CONFIG_CHIP_FACTORY_DATA=y
CONFIG_CHIP_FACTORY_DATA_BUILD=y
CONFIG_CHIP_FACTORY_DATA_USE_DEFAULT_CERTS=n
CONFIG_CHIP_FACTORY_DATA_CERT_SOURCE_GENERATED=y
CONFIG_CHIP_FACTORY_DATA_MERGE_WITH_FIRMWARE=y
CONFIG_CHIP_DEVICE_GENERATE_ROTATING_DEVICE_UID=n

# Set up the Factory Data
CONFIG_CHIP_DEVICE_SERIAL_NUMBER="1"
CONFIG_CHIP_DEVICE_VENDOR_ID=65521
CONFIG_CHIP_DEVICE_VENDOR_NAME="Nordic Semiconductor ASA"
CONFIG_CHIP_DEVICE_PRODUCT_ID=32774
CONFIG_CHIP_DEVICE_PRODUCT_NAME="Door Lock"
CONFIG_CHIP_DEVICE_MANUFACTURING_DATE="2023-02-01"
CONFIG_CHIP_DEVICE_HARDWARE_VERSION=1
CONFIG_CHIP_DEVICE_HARDWARE_VERSION_STRING="SVE_Spring2023"
CONFIG_CHIP_DEVICE_DISCRIMINATOR=0xE46
CONFIG_CHIP_DEVICE_SPAKE2_PASSCODE=28073715
CONFIG_CHIP_DEVICE_SPAKE2_IT=1000
CONFIG_CHIP_DEVICE_SPAKE2_TEST_VERIFIER="XUQaKLznAVZ+WEWkSTIEJwvjaU/CuWY1qLbRKuS56VEE4Us+aJNGy3B3tLClZWRDAS5yXUgku5pHyFLgVTAKXQIo663Y2L7HvrJh/8jlD0OTNDDLlsnjKdj+l0b2rC3vMg=="
CONFIG_CHIP_DEVICE_ROTATING_DEVICE_UID="0989f27796617e00ff9dc844496dbcf3"
CONFIG_CHIP_DEVICE_ENABLE_KEY="d229322af1412d66ebeda07e0d39b80e"

CONFIG_CHIP_FACTORY_DATA_CERT_SOURCE_USER=y
CONFIG_CHIP_FACTORY_DATA_USER_CERTS_DAC_CERT="/work/nrfconnect/nrf/samples/matter/lock/factory_data_new_1/DAC-Cert.der"
CONFIG_CHIP_FACTORY_DATA_USER_CERTS_DAC_KEY="/work/nrfconnect/nrf/samples/matter/lock/factory_data_new_1/DAC-Key.der"
CONFIG_CHIP_FACTORY_DATA_USER_CERTS_PAI_CERT="/work/nrfconnect/nrf/samples/matter/lock/factory_data_new_1/PAI-Cert.der"
```

## overlay-factory_data_build_2.conf
```kconfig
#
# Copyright (c) 2023 Nordic Semiconductor ASA
#
# SPDX-License-Identifier: LicenseRef-Nordic-5-Clause
#

# Use this overlay to re-generate new PAI and DAC certificates.
# Be sure that chip-cert executable is added to your system PATH.

# Enable building the new factory data
CONFIG_CHIP_FACTORY_DATA=y
CONFIG_CHIP_FACTORY_DATA_BUILD=y
CONFIG_CHIP_FACTORY_DATA_USE_DEFAULT_CERTS=n
CONFIG_CHIP_FACTORY_DATA_CERT_SOURCE_GENERATED=y
CONFIG_CHIP_FACTORY_DATA_MERGE_WITH_FIRMWARE=y
CONFIG_CHIP_DEVICE_GENERATE_ROTATING_DEVICE_UID=n

# Set up the Factory Data
CONFIG_CHIP_DEVICE_SERIAL_NUMBER="2"
CONFIG_CHIP_DEVICE_VENDOR_ID=65521
CONFIG_CHIP_DEVICE_VENDOR_NAME="Nordic Semiconductor ASA"
CONFIG_CHIP_DEVICE_PRODUCT_ID=32774
CONFIG_CHIP_DEVICE_PRODUCT_NAME="Door Lock"
CONFIG_CHIP_DEVICE_MANUFACTURING_DATE="2023-02-01"
CONFIG_CHIP_DEVICE_HARDWARE_VERSION=1
CONFIG_CHIP_DEVICE_HARDWARE_VERSION_STRING="SVE_Spring2023"
CONFIG_CHIP_DEVICE_DISCRIMINATOR=0x1fa
CONFIG_CHIP_DEVICE_SPAKE2_PASSCODE=80327003
CONFIG_CHIP_DEVICE_SPAKE2_IT=1000
CONFIG_CHIP_DEVICE_SPAKE2_TEST_VERIFIER="sMpmMvNf6t1TROKCjV9CnYwCMMV7l5YyXX/ajicjG1MEkZx8Ylg73OpW6w+BpfWeFgUBHreWf166zwxaTaY53y6cIFnu9HvWQofN0yKmnRjDZyZpBpb+2pR7bIdqUxcHcw=="
CONFIG_CHIP_DEVICE_ROTATING_DEVICE_UID="462a2785f8536233d6ce0427970fc596"
CONFIG_CHIP_DEVICE_ENABLE_KEY="5a9f1b3e358cc9934900aa6a2a085024"

CONFIG_CHIP_FACTORY_DATA_CERT_SOURCE_USER=y
CONFIG_CHIP_FACTORY_DATA_USER_CERTS_DAC_CERT="/work/nrfconnect/nrf/samples/matter/lock/factory_data_new_2/DAC-Cert.der"
CONFIG_CHIP_FACTORY_DATA_USER_CERTS_DAC_KEY="/work/nrfconnect/nrf/samples/matter/lock/factory_data_new_2/DAC-Key.der"
CONFIG_CHIP_FACTORY_DATA_USER_CERTS_PAI_CERT="/work/nrfconnect/nrf/samples/matter/lock/factory_data_new_2/PAI-Cert.der"
```

## prj_multi_image_dfu.conf
```kconfig
#
# Copyright (c) 2021 Nordic Semiconductor ASA
#
# SPDX-License-Identifier: LicenseRef-Nordic-5-Clause
#

# Enable CHIP
CONFIG_CHIP=y
CONFIG_CHIP_PROJECT_CONFIG="src/chip_project_config.h"
CONFIG_STD_CPP14=y

# General networking settings
CONFIG_NETWORKING=y
CONFIG_NET_IPV6_NBR_CACHE=n
CONFIG_NET_IPV6_MLD=n
CONFIG_NET_SOCKETS_POLL_MAX=5

# Enable OpenThread MTD
CONFIG_NET_L2_OPENTHREAD=y

CONFIG_OPENTHREAD_MTD=y
CONFIG_OPENTHREAD_FTD=n
CONFIG_OPENTHREAD_SLAAC=y
CONFIG_OPENTHREAD_MTD_NETDIAG=y
CONFIG_OPENTHREAD_MANUAL_START=y
CONFIG_OPENTHREAD_THREAD_STACK_SIZE=6144
CONFIG_OPENTHREAD_NUM_MESSAGE_BUFFERS=64

CONFIG_OPENTHREAD_PANID=4660
CONFIG_OPENTHREAD_CHANNEL=15
CONFIG_OPENTHREAD_NETWORK_NAME="OpenThread"
CONFIG_OPENTHREAD_XPANID="11:11:11:11:22:22:22:22"

# Enable Bluetooth Low Energy
CONFIG_BT=y
CONFIG_BT_PERIPHERAL=y
CONFIG_BT_PERIPHERAL_PREF_MIN_INT=12
CONFIG_BT_PERIPHERAL_PREF_MAX_INT=12
CONFIG_BT_GAP_AUTO_UPDATE_CONN_PARAMS=y
CONFIG_BT_GATT_DYNAMIC_DB=y
CONFIG_BT_DEVICE_APPEARANCE=0
CONFIG_BT_DEVICE_NAME_DYNAMIC=y
CONFIG_BT_DEVICE_NAME_MAX=15
CONFIG_BT_DEVICE_NAME="MatterLock"
CONFIG_BT_MAX_CONN=1
CONFIG_BT_SMP=y
CONFIG_BT_PRIVACY=y
CONFIG_BT_MAX_PAIRED=0
CONFIG_BT_BONDABLE=n
CONFIG_BT_TINYCRYPT_ECC=n
CONFIG_BT_SMP_OOB_LEGACY_PAIR_ONLY=y

# Use NFC to share commissioning information
# CONFIG_CHIP_NFC_COMMISSIONING=y

# Use nrf_security
CONFIG_OPENTHREAD_NRF_SECURITY_CHOICE=y

CONFIG_CC3XX_BACKEND=y
CONFIG_OBERON_BACKEND=y

CONFIG_MBEDTLS_ENABLE_HEAP=y
CONFIG_MBEDTLS_HEAP_SIZE=15360
CONFIG_MBEDTLS_TLS_LIBRARY=y
CONFIG_NRF_SECURITY_ADVANCED=y

CONFIG_MBEDTLS_AES_C=y
CONFIG_MBEDTLS_ECP_C=y
CONFIG_MBEDTLS_ECP_DP_SECP256R1_ENABLED=y
CONFIG_MBEDTLS_CTR_DRBG_C=y
CONFIG_MBEDTLS_CIPHER_MODE_CTR=y
CONFIG_MBEDTLS_ECJPAKE_C=y
CONFIG_MBEDTLS_SHA256_C=y
CONFIG_MBEDTLS_PK_C=y
CONFIG_MBEDTLS_PK_WRITE_C=y
CONFIG_MBEDTLS_X509_CREATE_C=y
CONFIG_MBEDTLS_X509_CSR_WRITE_C=y

# Use SHA256 implementation from Oberon
CONFIG_CHOICE_OBERON_MBEDTLS_SHA256_C=y

# Disable unneeded crypto operations
CONFIG_MBEDTLS_SHA512_C=n
CONFIG_MBEDTLS_CIPHER_MODE_XTS=n
CONFIG_MBEDTLS_CHACHA20_C=n
CONFIG_MBEDTLS_POLY1305_C=n
CONFIG_MBEDTLS_CHACHAPOLY_C=n
CONFIG_MBEDTLS_GCM_C=n
CONFIG_MBEDTLS_RSA_C=n
CONFIG_OBERON_MBEDTLS_AES_C=n

# Add support for LEDs and buttons on Nordic development kits
CONFIG_DK_LIBRARY=y

# Other settings
CONFIG_LOG=y
CONFIG_LOG_MODE_MINIMAL=y
CONFIG_PRINTK_SYNC=y
CONFIG_MAIN_STACK_SIZE=8192
CONFIG_INIT_STACKS=y
CONFIG_HW_STACK_PROTECTION=y
CONFIG_THREAD_NAME=y
CONFIG_SHELL=y

# Enable bootloader and DFU related configs
CONFIG_BOOTLOADER_MCUBOOT=y
CONFIG_UPDATEABLE_IMAGE_NUMBER=2

# QSPI configuration
CONFIG_NORDIC_QSPI_NOR=y
CONFIG_NORDIC_QSPI_NOR_FLASH_LAYOUT_PAGE_SIZE=4096
CONFIG_NORDIC_QSPI_NOR_STACK_WRITE_BUFFER_SIZE=16

# MCU Manager and SMP configuration
CONFIG_MCUMGR=y
CONFIG_MCUMGR_CMD_IMG_MGMT=y
CONFIG_MCUMGR_CMD_OS_MGMT=y
CONFIG_MCUMGR_SMP_BT=y
CONFIG_MCUMGR_SMP_BT_AUTHEN=n
CONFIG_MCUMGR_BUF_COUNT=6

# Increase BT MTU and RX buffer for big size DFU messages
CONFIG_BT_L2CAP_TX_MTU=498
CONFIG_BT_BUF_ACL_TX_SIZE=251
CONFIG_BT_BUF_ACL_RX_SIZE=502

# Increase max number of pending GATT notification callbacks
CONFIG_BT_CONN_TX_MAX=6

# Increase system workqueue size, as SMP is processed within it
CONFIG_SYSTEM_WORKQUEUE_STACK_SIZE=2800

# FLASH nop device is enabled to prevent bus faults when mcumgr tries to access
# simulated partition with network core image data.
CONFIG_FLASH_NOP_DEVICE=y

# Enable custom SMP request to erase settings partition.
CONFIG_MCUMGR_GRP_ZEPHYR_BASIC=y
CONFIG_MCUMGR_GRP_BASIC_CMD_STORAGE_ERASE=y
```

## prj_release.conf
```kconfig
#
# Copyright (c) 2022 Nordic Semiconductor ASA
#
# SPDX-License-Identifier: LicenseRef-Nordic-5-Clause
#

# This sample uses Kconfig.defaults to set options common for all
# samples. This file should contain only options specific for this sample
# or overrides of default values.

# Enable CHIP
CONFIG_CHIP=y
CONFIG_CHIP_PROJECT_CONFIG="src/chip_project_config.h"
CONFIG_CHIP_DEVICE_PRODUCT_NAME="Matter Door Lock"

# Configure ZAP file name
CONFIG_NCS_SAMPLE_MATTER_ZAP_FILE_PATH="${APPLICATION_CONFIG_DIR}/src/default_zap/lock.zap"

# 32774 == 0x8006 (example lock-app)
CONFIG_CHIP_DEVICE_PRODUCT_ID=32774
CONFIG_STD_CPP17=y

# Enable Matter extended announcement and increase duration to 1 hour.
CONFIG_CHIP_BLE_EXT_ADVERTISING=y
CONFIG_CHIP_BLE_ADVERTISING_DURATION=60

# Add support for LEDs and buttons on Nordic development kits
CONFIG_DK_LIBRARY=y

# Bluetooth Low Energy configuration
CONFIG_BT_DEVICE_NAME="MatterLock"

# # Suspend devices when the CPU goes into sleep
# CONFIG_PM_DEVICE=y

# Enable system reset on fatal error
CONFIG_RESET_ON_FATAL_ERROR=y

# Try to disable unused RAM blocks to reduce power consumption
CONFIG_RAM_POWER_DOWN_LIBRARY=y

# Disable all debug features
CONFIG_USE_SEGGER_RTT=n
CONFIG_SHELL=n
CONFIG_OPENTHREAD_SHELL=n
CONFIG_CONSOLE=n
CONFIG_UART_CONSOLE=n
CONFIG_SERIAL=n
CONFIG_LOG=n
CONFIG_LOG_MODE_MINIMAL=n
CONFIG_ASSERT_VERBOSE=n
CONFIG_ASSERT_NO_FILE_INFO=y
CONFIG_PRINTK=n
CONFIG_PRINTK_SYNC=n
CONFIG_THREAD_NAME=n
CONFIG_BOOT_BANNER=n

# Enable Factory Data feature
CONFIG_CHIP_FACTORY_DATA=y
CONFIG_CHIP_FACTORY_DATA_BUILD=y

# Enable Watchdog
CONFIG_NCS_SAMPLE_MATTER_WATCHDOG=y

# Enable LTO to decrease the flash usage.
CONFIG_LTO=y
CONFIG_ISR_TABLES_LOCAL_DECLARATION=y
```

## prj_single_image_dfu.conf
```kconfig
#
# Copyright (c) 2021 Nordic Semiconductor ASA
#
# SPDX-License-Identifier: LicenseRef-Nordic-5-Clause
#

# Enable CHIP
CONFIG_CHIP=y
CONFIG_CHIP_PROJECT_CONFIG="src/chip_project_config.h"
CONFIG_STD_CPP14=y

# General networking settings
CONFIG_NETWORKING=y
CONFIG_NET_IPV6_NBR_CACHE=n
CONFIG_NET_IPV6_MLD=n
CONFIG_NET_SOCKETS_POLL_MAX=5

# Enable OpenThread MTD
CONFIG_NET_L2_OPENTHREAD=y

CONFIG_OPENTHREAD_MTD=y
CONFIG_OPENTHREAD_FTD=n
CONFIG_OPENTHREAD_SLAAC=y
CONFIG_OPENTHREAD_MTD_NETDIAG=y
CONFIG_OPENTHREAD_MANUAL_START=y
CONFIG_OPENTHREAD_THREAD_STACK_SIZE=6144
CONFIG_OPENTHREAD_NUM_MESSAGE_BUFFERS=64

CONFIG_OPENTHREAD_PANID=4660
CONFIG_OPENTHREAD_CHANNEL=15
CONFIG_OPENTHREAD_NETWORK_NAME="OpenThread"
CONFIG_OPENTHREAD_XPANID="11:11:11:11:22:22:22:22"

# Enable Bluetooth Low Energy
CONFIG_BT=y
CONFIG_BT_PERIPHERAL=y
CONFIG_BT_PERIPHERAL_PREF_MIN_INT=12
CONFIG_BT_PERIPHERAL_PREF_MAX_INT=12
CONFIG_BT_GAP_AUTO_UPDATE_CONN_PARAMS=y
CONFIG_BT_GATT_DYNAMIC_DB=y
CONFIG_BT_DEVICE_APPEARANCE=0
CONFIG_BT_DEVICE_NAME_DYNAMIC=y
CONFIG_BT_DEVICE_NAME_MAX=15
CONFIG_BT_DEVICE_NAME="MatterLock"
CONFIG_BT_MAX_CONN=1
CONFIG_BT_SMP=y
CONFIG_BT_PRIVACY=y
CONFIG_BT_MAX_PAIRED=0
CONFIG_BT_BONDABLE=n
CONFIG_BT_TINYCRYPT_ECC=n
CONFIG_BT_SMP_OOB_LEGACY_PAIR_ONLY=y

# Use NFC to share commissioning information
# CONFIG_CHIP_NFC_COMMISSIONING=y

# Use nrf_security
CONFIG_OPENTHREAD_NRF_SECURITY_CHOICE=y

CONFIG_CC3XX_BACKEND=y
CONFIG_OBERON_BACKEND=y

CONFIG_MBEDTLS_ENABLE_HEAP=y
CONFIG_MBEDTLS_HEAP_SIZE=15360
CONFIG_MBEDTLS_TLS_LIBRARY=y
CONFIG_NRF_SECURITY_ADVANCED=y

CONFIG_MBEDTLS_AES_C=y
CONFIG_MBEDTLS_ECP_C=y
CONFIG_MBEDTLS_ECP_DP_SECP256R1_ENABLED=y
CONFIG_MBEDTLS_CTR_DRBG_C=y
CONFIG_MBEDTLS_CIPHER_MODE_CTR=y
CONFIG_MBEDTLS_ECJPAKE_C=y
CONFIG_MBEDTLS_SHA256_C=y
CONFIG_MBEDTLS_PK_C=y
CONFIG_MBEDTLS_PK_WRITE_C=y
CONFIG_MBEDTLS_X509_CREATE_C=y
CONFIG_MBEDTLS_X509_CSR_WRITE_C=y

# Use SHA256 implementation from Oberon
CONFIG_CHOICE_OBERON_MBEDTLS_SHA256_C=y

# Disable unneeded crypto operations
CONFIG_MBEDTLS_SHA512_C=n
CONFIG_MBEDTLS_CIPHER_MODE_XTS=n
CONFIG_MBEDTLS_CHACHA20_C=n
CONFIG_MBEDTLS_POLY1305_C=n
CONFIG_MBEDTLS_CHACHAPOLY_C=n
CONFIG_MBEDTLS_GCM_C=n
CONFIG_MBEDTLS_RSA_C=n
CONFIG_OBERON_MBEDTLS_AES_C=n

# Add support for LEDs and buttons on Nordic development kits
CONFIG_DK_LIBRARY=y

# Other settings
CONFIG_LOG=y
CONFIG_LOG_MODE_MINIMAL=y
CONFIG_PRINTK_SYNC=y
CONFIG_MAIN_STACK_SIZE=8192
CONFIG_INIT_STACKS=y
CONFIG_HW_STACK_PROTECTION=y
CONFIG_THREAD_NAME=y
CONFIG_SHELL=y

# Enable bootloader and DFU related configs
CONFIG_BOOTLOADER_MCUBOOT=y

# QSPI configuration
CONFIG_NORDIC_QSPI_NOR=y
CONFIG_NORDIC_QSPI_NOR_FLASH_LAYOUT_PAGE_SIZE=4096
CONFIG_NORDIC_QSPI_NOR_STACK_WRITE_BUFFER_SIZE=16

# MCU Manager and SMP configuration
CONFIG_MCUMGR=y
CONFIG_MCUMGR_CMD_IMG_MGMT=y
CONFIG_MCUMGR_CMD_OS_MGMT=y
CONFIG_MCUMGR_SMP_BT=y
CONFIG_MCUMGR_SMP_BT_AUTHEN=n
CONFIG_MCUMGR_BUF_COUNT=6

# Increase BT MTU and RX buffer for big size DFU messages
CONFIG_BT_L2CAP_TX_MTU=498
CONFIG_BT_BUF_ACL_TX_SIZE=251
CONFIG_BT_BUF_ACL_RX_SIZE=502

# Increase max number of pending GATT notification callbacks
CONFIG_BT_CONN_TX_MAX=6

# Increase MCUMGR_BUF_SIZE, as it must be big enough to fit MAX MTU + overhead and for single-image DFU default is 384 B
CONFIG_MCUMGR_BUF_SIZE=1024

# Increase system workqueue size, as SMP is processed within it
CONFIG_SYSTEM_WORKQUEUE_STACK_SIZE=2800
```

## src/app_task.cpp
```c
/*
 * Copyright (c) 2021 Nordic Semiconductor ASA
 *
 * SPDX-License-Identifier: LicenseRef-Nordic-5-Clause
 */

#include "app_task.h"

#include "bolt_lock_manager.h"

#ifdef CONFIG_THREAD_WIFI_SWITCHING
#include "thread_wifi_switch.h"
#endif

#include "app/matter_init.h"
#include "app/task_executor.h"

#ifdef CONFIG_CHIP_NUS
#include "bt_nus/bt_nus_service.h"
#endif

#ifdef CONFIG_CHIP_OTA_REQUESTOR
#include "dfu/ota/ota_util.h"
#endif

#include <app-common/zap-generated/attributes/Accessors.h>
#include <app/clusters/door-lock-server/door-lock-server.h>
#include <app/clusters/identify-server/identify-server.h>
#include <app/server/OnboardingCodesUtil.h>
#include <platform/CHIPDeviceLayer.h>

#include <zephyr/logging/log.h>

LOG_MODULE_DECLARE(app, CONFIG_CHIP_APP_LOG_LEVEL);

using namespace ::chip;
using namespace ::chip::app;
using namespace ::chip::DeviceLayer;

namespace
{
constexpr EndpointId kLockEndpointId = 1;

#ifdef CONFIG_CHIP_NUS
constexpr uint16_t kAdvertisingIntervalMin = 400;
constexpr uint16_t kAdvertisingIntervalMax = 500;
constexpr uint8_t kLockNUSPriority = 2;
#endif

#ifdef CONFIG_THREAD_WIFI_SWITCHING
k_timer sSwitchTransportTimer;
constexpr uint32_t kSwitchTransportTimeout = 10000;
#endif

#define APPLICATION_BUTTON_MASK DK_BTN2_MSK

#ifdef CONFIG_CHIP_ICD_UAT_SUPPORT
#define UAT_BUTTON_MASK DK_BTN3_MSK
#else
#define SWITCHING_BUTTON_MASK DK_BTN3_MSK
#endif

} /* namespace */

Identify sIdentify = { kLockEndpointId, AppTask::IdentifyStartHandler, AppTask::IdentifyStopHandler,
		       Clusters::Identify::IdentifyTypeEnum::kVisibleIndicator };

DelegateImpl AppTask::sLockDelegate;

CHIP_ERROR DelegateImpl::GetAliroReaderVerificationKey(MutableByteSpan &verificationKey)
{
	if (!mAliroStateInitialized) {
		verificationKey.reduce_size(0);
		return CHIP_NO_ERROR;
	}

	return chip::CopySpanToMutableSpan(ByteSpan(mAliroReaderVerificationKey), verificationKey);
}

CHIP_ERROR DelegateImpl::GetAliroReaderGroupIdentifier(MutableByteSpan &groupIdentifier)
{
	if (!mAliroStateInitialized) {
		groupIdentifier.reduce_size(0);
		return CHIP_NO_ERROR;
	}

	return chip::CopySpanToMutableSpan(ByteSpan(mAliroReaderGroupIdentifier), groupIdentifier);
}

CHIP_ERROR DelegateImpl::GetAliroReaderGroupSubIdentifier(MutableByteSpan &groupSubIdentifier)
{
	return chip::CopySpanToMutableSpan(ByteSpan(mAliroReaderGroupSubIdentifier), groupSubIdentifier);
}

CHIP_ERROR DelegateImpl::CopyProtocolVersionIntoSpan(uint16_t protocolVersionValue, MutableByteSpan &protocolVersion)
{
	using namespace chip::app::Clusters::DoorLock;

	static_assert(sizeof(protocolVersionValue) == kAliroProtocolVersionSize);

	if (protocolVersion.size() < kAliroProtocolVersionSize) {
		return CHIP_ERROR_INVALID_ARGUMENT;
	}

	// Per Aliro spec, protocol version encoding is big-endian
	chip::Encoding::BigEndian::Put16(protocolVersion.data(), protocolVersionValue);
	protocolVersion.reduce_size(kAliroProtocolVersionSize);
	return CHIP_NO_ERROR;
}

CHIP_ERROR DelegateImpl::GetAliroExpeditedTransactionSupportedProtocolVersionAtIndex(size_t index,
										     MutableByteSpan &protocolVersion)
{
	// Only claim support for the one known protocol version for now: 0x0100.
	constexpr uint16_t knownProtocolVersion = 0x0100;

	if (index > 0) {
		return CHIP_ERROR_PROVIDER_LIST_EXHAUSTED;
	}

	return CopyProtocolVersionIntoSpan(knownProtocolVersion, protocolVersion);
}

CHIP_ERROR DelegateImpl::GetAliroGroupResolvingKey(MutableByteSpan &groupResolvingKey)
{
	if (!mAliroStateInitialized) {
		groupResolvingKey.reduce_size(0);
		return CHIP_NO_ERROR;
	}

	return chip::CopySpanToMutableSpan(ByteSpan(mAliroGroupResolvingKey), groupResolvingKey);
}

CHIP_ERROR DelegateImpl::GetAliroSupportedBLEUWBProtocolVersionAtIndex(size_t index, MutableByteSpan &protocolVersion)
{
	// Only claim support for the one known protocol version for now: 0x0100.
	constexpr uint16_t knownProtocolVersion = 0x0100;

	if (index > 0) {
		return CHIP_ERROR_PROVIDER_LIST_EXHAUSTED;
	}

	return CopyProtocolVersionIntoSpan(knownProtocolVersion, protocolVersion);
}

uint8_t DelegateImpl::GetAliroBLEAdvertisingVersion()
{
	// For now the only define value of the BLE advertising version for Aliro is 0.
	return 0;
}

uint16_t DelegateImpl::GetNumberOfAliroCredentialIssuerKeysSupported()
{
	return 5;
}

uint16_t DelegateImpl::GetNumberOfAliroEndpointKeysSupported()
{
	return 5;
}

CHIP_ERROR DelegateImpl::SetAliroReaderConfig(const ByteSpan &signingKey, const ByteSpan &verificationKey,
					      const ByteSpan &groupIdentifier,
					      const Optional<ByteSpan> &groupResolvingKey)
{
	// We ignore the signing key, since we never do anything with it.

	VerifyOrReturnError(verificationKey.size() == sizeof(mAliroReaderVerificationKey), CHIP_ERROR_INVALID_ARGUMENT);
	memcpy(mAliroReaderVerificationKey, verificationKey.data(), sizeof(mAliroReaderVerificationKey));

	VerifyOrReturnError(groupIdentifier.size() == sizeof(mAliroReaderGroupIdentifier), CHIP_ERROR_INVALID_ARGUMENT);
	memcpy(mAliroReaderGroupIdentifier, groupIdentifier.data(), sizeof(mAliroReaderGroupIdentifier));

	if (groupResolvingKey.HasValue()) {
		VerifyOrReturnError(groupResolvingKey.Value().size() == sizeof(mAliroGroupResolvingKey),
				    CHIP_ERROR_INVALID_ARGUMENT);
		memcpy(mAliroGroupResolvingKey, groupResolvingKey.Value().data(), sizeof(mAliroGroupResolvingKey));
	}

	mAliroStateInitialized = true;
	return CHIP_NO_ERROR;
}

CHIP_ERROR DelegateImpl::ClearAliroReaderConfig()
{
	// A real implementation would clear out key data from the other parts of
	// the application that might use it.
	mAliroStateInitialized = false;
	return CHIP_NO_ERROR;
}

void AppTask::IdentifyStartHandler(Identify *)
{
	Nrf::PostTask(
		[] { Nrf::GetBoard().GetLED(Nrf::DeviceLeds::LED2).Blink(Nrf::LedConsts::kIdentifyBlinkRate_ms); });
}

void AppTask::IdentifyStopHandler(Identify *)
{
	Nrf::PostTask([] { Nrf::GetBoard().GetLED(Nrf::DeviceLeds::LED2).Set(BoltLockMgr().IsLocked()); });
}

void AppTask::ButtonEventHandler(Nrf::ButtonState state, Nrf::ButtonMask hasChanged)
{
	if ((APPLICATION_BUTTON_MASK & hasChanged) & state) {
		Nrf::PostTask([] { LockActionEventHandler(); });
	}

#ifdef CONFIG_THREAD_WIFI_SWITCHING
	if (SWITCHING_BUTTON_MASK & hasChanged) {
		SwitchButtonAction action =
			(SWITCHING_BUTTON_MASK & state) ? SwitchButtonAction::Pressed : SwitchButtonAction::Released;
		Nrf::PostTask([action] { SwitchTransportTriggerHandler(action); });
	}
#endif

#ifdef CONFIG_CHIP_ICD_UAT_SUPPORT
	if ((UAT_BUTTON_MASK & state & hasChanged)) {
		LOG_INF("ICD UserActiveMode has been triggered.");
		// Temporarily claim network activity, until we implement a "user trigger" reason for ICD wakeups.
		PlatformMgr().ScheduleWork(
			[](intptr_t) { ICDNotifier::GetInstance().NotifyNetworkActivityNotification(); });
	}
#endif
}

void AppTask::LockActionEventHandler()
{
	if (BoltLockMgr().IsLocked()) {
		BoltLockMgr().Unlock(BoltLockManager::OperationSource::kButton);
	} else {
		BoltLockMgr().Lock(BoltLockManager::OperationSource::kButton);
	}
}

#ifdef CONFIG_THREAD_WIFI_SWITCHING
void AppTask::SwitchTransportEventHandler()
{
	LOG_INF("Switching to %s", ThreadWifiSwitch::IsThreadActive() ? "Wi-Fi" : "Thread");

	ThreadWifiSwitch::SwitchTransport();
}

void AppTask::SwitchTransportTimerTimeoutCallback(k_timer *timer)
{
	Nrf::PostTask([] { SwitchTransportEventHandler(); });
}

void AppTask::SwitchTransportTriggerHandler(const SwitchButtonAction &action)
{
	if (action == SwitchButtonAction::Pressed) {
		LOG_INF("Keep button pressed for %u ms to switch to %s", kSwitchTransportTimeout,
			ThreadWifiSwitch::IsThreadActive() ? "Wi-Fi" : "Thread");
		k_timer_start(&sSwitchTransportTimer, K_MSEC(kSwitchTransportTimeout), K_NO_WAIT);
	} else {
		LOG_INF("Switching to %s cancelled", ThreadWifiSwitch::IsThreadActive() ? "Wi-Fi" : "Thread");
		k_timer_stop(&sSwitchTransportTimer);
	}
}
#endif

void AppTask::LockStateChanged(BoltLockManager::State state, BoltLockManager::OperationSource source)
{
	switch (state) {
	case BoltLockManager::State::kLockingInitiated:
		LOG_INF("Lock action initiated");
		Nrf::GetBoard().GetLED(Nrf::DeviceLeds::LED2).Blink(50, 50);
#ifdef CONFIG_CHIP_NUS
		Nrf::GetNUSService().SendData("locking", sizeof("locking"));
#endif
		break;
	case BoltLockManager::State::kLockingCompleted:
		LOG_INF("Lock action completed");
		Nrf::GetBoard().GetLED(Nrf::DeviceLeds::LED2).Set(true);
#ifdef CONFIG_CHIP_NUS
		Nrf::GetNUSService().SendData("locked", sizeof("locked"));
#endif
		break;
	case BoltLockManager::State::kUnlockingInitiated:
		LOG_INF("Unlock action initiated");
		Nrf::GetBoard().GetLED(Nrf::DeviceLeds::LED2).Blink(50, 50);
#ifdef CONFIG_CHIP_NUS
		Nrf::GetNUSService().SendData("unlocking", sizeof("unlocking"));
#endif
		break;
	case BoltLockManager::State::kUnlockingCompleted:
		LOG_INF("Unlock action completed");
#ifdef CONFIG_CHIP_NUS
		Nrf::GetNUSService().SendData("unlocked", sizeof("unlocked"));
#endif
		Nrf::GetBoard().GetLED(Nrf::DeviceLeds::LED2).Set(false);
		break;
	}

	/* Handle changing attribute state in the application */
	Instance().UpdateClusterState(state, source);
}

void AppTask::UpdateClusterState(BoltLockManager::State state, BoltLockManager::OperationSource source)
{
	DlLockState newLockState;

	switch (state) {
	case BoltLockManager::State::kLockingCompleted:
		newLockState = DlLockState::kLocked;
		break;
	case BoltLockManager::State::kUnlockingCompleted:
		newLockState = DlLockState::kUnlocked;
		break;
	default:
		newLockState = DlLockState::kNotFullyLocked;
		break;
	}

	SystemLayer().ScheduleLambda([newLockState, source] {
		chip::app::DataModel::Nullable<chip::app::Clusters::DoorLock::DlLockState> currentLockState;
		chip::app::Clusters::DoorLock::Attributes::LockState::Get(kLockEndpointId, currentLockState);

		if (currentLockState.IsNull()) {
			/* Initialize lock state with start value, but not invoke lock/unlock. */
			chip::app::Clusters::DoorLock::Attributes::LockState::Set(kLockEndpointId, newLockState);
		} else {
			LOG_INF("Updating LockState attribute");

			if (!DoorLockServer::Instance().SetLockState(kLockEndpointId, newLockState, source)) {
				LOG_ERR("Failed to update LockState attribute");
			}
		}
	});
}

#ifdef CONFIG_CHIP_NUS
void AppTask::NUSLockCallback(void *context)
{
	LOG_DBG("Received LOCK command from NUS");
	if (BoltLockMgr().mState == BoltLockManager::State::kLockingCompleted ||
	    BoltLockMgr().mState == BoltLockManager::State::kLockingInitiated) {
		LOG_INF("Device is already locked");
	} else {
		Nrf::PostTask([] { LockActionEventHandler(); });
	}
}

void AppTask::NUSUnlockCallback(void *context)
{
	LOG_DBG("Received UNLOCK command from NUS");
	if (BoltLockMgr().mState == BoltLockManager::State::kUnlockingCompleted ||
	    BoltLockMgr().mState == BoltLockManager::State::kUnlockingInitiated) {
		LOG_INF("Device is already unlocked");
	} else {
		Nrf::PostTask([] { LockActionEventHandler(); });
	}
}
#endif

#ifdef CONFIG_NCS_SAMPLE_MATTER_TEST_EVENT_TRIGGERS
CHIP_ERROR AppTask::DoorLockJammedEventCallback(Nrf::Matter::TestEventTrigger::TriggerValue)
{
	VerifyOrReturnError(DoorLockServer::Instance().SendLockAlarmEvent(kLockEndpointId, AlarmCodeEnum::kLockJammed),
			    CHIP_ERROR_INTERNAL);
	LOG_ERR("Event Trigger: Doorlock jammed.");
	return CHIP_NO_ERROR;
}
#endif

CHIP_ERROR AppTask::Init()
{
	/* Initialize Matter stack */
#ifdef CONFIG_THREAD_WIFI_SWITCHING
	/* In the Thread/Wi-Fi switchable mode, it is the ThreadWifiSwitch module that owns the NetworkCommissioning
	   instances, so offload the initialization module from controlling that by explicitly setting the
	   mNetworkingInstance parameter to nullptr. Otherwise, the initialization module instantiates the
	   NetworkCommissioning object and handles it by default internally. */
	ReturnErrorOnFailure(Nrf::Matter::PrepareServer(Nrf::Matter::InitData{ .mNetworkingInstance = nullptr }));
#else
	ReturnErrorOnFailure(Nrf::Matter::PrepareServer());
#endif

	if (!Nrf::GetBoard().Init(ButtonEventHandler)) {
		LOG_ERR("User interface initialization failed.");
		return CHIP_ERROR_INCORRECT_STATE;
	}

	/* Register Matter event handler that controls the connectivity status LED based on the captured Matter network
	 * state. */
	ReturnErrorOnFailure(Nrf::Matter::RegisterEventHandler(Nrf::Board::DefaultMatterEventHandler, 0));

#ifdef CONFIG_THREAD_WIFI_SWITCHING
	CHIP_ERROR err = ThreadWifiSwitch::StartCurrentTransport();
	if (err != CHIP_NO_ERROR) {
		LOG_ERR("ThreadWifiSwitch::StartCurrentTransport() failed: %" CHIP_ERROR_FORMAT, err.Format());
		return err;
	}

	k_timer_init(&sSwitchTransportTimer, &AppTask::SwitchTransportTimerTimeoutCallback, nullptr);
#endif

#ifdef CONFIG_CHIP_NUS
	/* Initialize Nordic UART Service for Lock purposes */
	if (!Nrf::GetNUSService().Init(kLockNUSPriority, kAdvertisingIntervalMin, kAdvertisingIntervalMax)) {
		ChipLogError(Zcl, "Cannot initialize NUS service");
	}
	Nrf::GetNUSService().RegisterCommand("Lock", sizeof("Lock"), NUSLockCallback, nullptr);
	Nrf::GetNUSService().RegisterCommand("Unlock", sizeof("Unlock"), NUSUnlockCallback, nullptr);
	if (!Nrf::GetNUSService().StartServer()) {
		LOG_ERR("GetNUSService().StartServer() failed");
	}
#endif

	/* Initialize lock manager */
	BoltLockMgr().Init(LockStateChanged);

	/* Register Door Lock test event trigger */
#ifdef CONFIG_NCS_SAMPLE_MATTER_TEST_EVENT_TRIGGERS
	ReturnErrorOnFailure(Nrf::Matter::TestEventTrigger::Instance().RegisterTestEventTrigger(
		kDoorLockJammedEventTriggerId,
		Nrf::Matter::TestEventTrigger::EventTrigger{ 0, DoorLockJammedEventCallback }));
#endif
	return Nrf::Matter::StartServer();
}

CHIP_ERROR AppTask::StartApp()
{
	ReturnErrorOnFailure(Init());

	while (true) {
		Nrf::DispatchNextTask();
	}

	return CHIP_NO_ERROR;
}
```

## src/app_task.h
```c
/*
 * Copyright (c) 2021 Nordic Semiconductor ASA
 *
 * SPDX-License-Identifier: LicenseRef-Nordic-5-Clause
 */

#pragma once

#include "board/board.h"
#include "board/led_widget.h"
#include "bolt_lock_manager.h"
#include <app/clusters/door-lock-server/door-lock-delegate.h>

struct k_timer;
struct Identify;

#ifdef CONFIG_THREAD_WIFI_SWITCHING
enum class SwitchButtonAction : uint8_t { Pressed, Released };
#endif

#ifdef CONFIG_NCS_SAMPLE_MATTER_TEST_EVENT_TRIGGERS
#include "event_triggers/event_triggers.h"
#endif

using namespace ::chip;
static constexpr size_t DOOR_LOCK_CREDENTIAL_INFO_MAX_DATA_SIZE = 20;
static constexpr size_t DOOR_LOCK_CREDENTIAL_INFO_MAX_TYPES     = 8; // 0: ProgrammingPIN ~ 5: Face


class DelegateImpl : public chip::app::Clusters::DoorLock::Delegate {
public:
	uint8_t mAliroReaderVerificationKey[chip::app::Clusters::DoorLock::kAliroReaderVerificationKeySize];
	uint8_t mAliroReaderGroupIdentifier[chip::app::Clusters::DoorLock::kAliroReaderGroupIdentifierSize];
	uint8_t mAliroReaderGroupSubIdentifier[chip::app::Clusters::DoorLock::kAliroReaderGroupSubIdentifierSize];
	uint8_t mAliroGroupResolvingKey[chip::app::Clusters::DoorLock::kAliroGroupResolvingKeySize];
	bool mAliroStateInitialized = false;
	CHIP_ERROR GetAliroReaderVerificationKey(MutableByteSpan & verificationKey) override;
	CHIP_ERROR GetAliroReaderGroupIdentifier(MutableByteSpan & groupIdentifier) override;
	CHIP_ERROR GetAliroReaderGroupSubIdentifier(MutableByteSpan & groupSubIdentifier) override;
	CHIP_ERROR CopyProtocolVersionIntoSpan(uint16_t protocolVersionValue, MutableByteSpan & protocolVersion);
	CHIP_ERROR GetAliroExpeditedTransactionSupportedProtocolVersionAtIndex(size_t index, MutableByteSpan & protocolVersion) override;
	CHIP_ERROR GetAliroGroupResolvingKey(MutableByteSpan & groupResolvingKey) override;
	CHIP_ERROR GetAliroSupportedBLEUWBProtocolVersionAtIndex(size_t index, MutableByteSpan & protocolVersion) override;
	uint8_t GetAliroBLEAdvertisingVersion() override;
	uint16_t GetNumberOfAliroCredentialIssuerKeysSupported() override;
	uint16_t GetNumberOfAliroEndpointKeysSupported() override;
	CHIP_ERROR SetAliroReaderConfig(const ByteSpan & signingKey, const ByteSpan & verificationKey,
							const ByteSpan & groupIdentifier, const Optional<ByteSpan> & groupResolvingKey) override;
	CHIP_ERROR ClearAliroReaderConfig() override;

};

class AppTask {
public:
	static AppTask &Instance()
	{
		static AppTask sAppTask;
		return sAppTask;
	};

	CHIP_ERROR StartApp();

	void UpdateClusterState(BoltLockManager::State state, BoltLockManager::OperationSource source);
	static void IdentifyStartHandler(Identify *);
	static void IdentifyStopHandler(Identify *);

private:
	CHIP_ERROR Init();

	static void LockActionEventHandler();
	static void ButtonEventHandler(Nrf::ButtonState state, Nrf::ButtonMask hasChanged);
	static void LockStateChanged(BoltLockManager::State state, BoltLockManager::OperationSource source);

#ifdef CONFIG_THREAD_WIFI_SWITCHING
	static void SwitchTransportEventHandler();
	static void SwitchTransportTimerTimeoutCallback(k_timer *timer);
	static void SwitchTransportTriggerHandler(const SwitchButtonAction &action);
#endif

#ifdef CONFIG_CHIP_NUS
	static void NUSLockCallback(void *context);
	static void NUSUnlockCallback(void *context);
#endif

#ifdef CONFIG_NCS_SAMPLE_MATTER_TEST_EVENT_TRIGGERS
	constexpr static Nrf::Matter::TestEventTrigger::EventTriggerId kDoorLockJammedEventTriggerId = 0xFFFF'FFFF'3277'4000;
	static CHIP_ERROR DoorLockJammedEventCallback(Nrf::Matter::TestEventTrigger::TriggerValue);
#endif
	static DelegateImpl sLockDelegate;
};
```

## src/bolt_lock_manager.h
```c
/*
 * Copyright (c) 2021 Nordic Semiconductor ASA
 *
 * SPDX-License-Identifier: LicenseRef-Nordic-5-Clause
 */

#pragma once

#include "access/access_manager.h"

#include <app/clusters/door-lock-server/door-lock-server.h>
#include <lib/core/ClusterEnums.h>

#include <zephyr/kernel.h>

#include <cstdint>

struct BoltLockManagerEvent;

class BoltLockManager {
public:
	static constexpr size_t kMaxCredentialLength = 128;

	enum class State : uint8_t {
		kLockingInitiated = 0,
		kLockingCompleted,
		kUnlockingInitiated,
		kUnlockingCompleted,
	};

	struct UserData {
		char mName[DOOR_LOCK_USER_NAME_BUFFER_SIZE];
		CredentialStruct mCredentials[CONFIG_LOCK_MAX_NUM_CREDENTIALS_PER_USER];
	};

	struct CredentialData {
		chip::Platform::ScopedMemoryBuffer<uint8_t> mSecret;
	};

	using OperationSource = chip::app::Clusters::DoorLock::OperationSourceEnum;
	using StateChangeCallback = void (*)(State, OperationSource);

	static constexpr uint32_t kActuatorMovementTimeMs = 2000;

	void Init(StateChangeCallback callback);

	State GetState() const { return mState; }
	bool IsLocked() const { return mState == State::kLockingCompleted; }

	bool GetUser(uint16_t userIndex, EmberAfPluginDoorLockUserInfo &user);
	bool SetUser(uint16_t userIndex, chip::FabricIndex creator, chip::FabricIndex modifier,
		     const chip::CharSpan &userName, uint32_t uniqueId, UserStatusEnum userStatus,
		     UserTypeEnum userType, CredentialRuleEnum credentialRule, const CredentialStruct *credentials,
		     size_t totalCredentials);

	bool GetCredential(uint16_t credentialIndex, CredentialTypeEnum credentialType,
			   EmberAfPluginDoorLockCredentialInfo &credential);
	bool SetCredential(uint16_t credentialIndex, chip::FabricIndex creator, chip::FabricIndex modifier,
			   DlCredentialStatus credentialStatus, CredentialTypeEnum credentialType,
			   const chip::ByteSpan &secret);

#ifdef CONFIG_LOCK_SCHEDULES
	DlStatus GetWeekDaySchedule(uint8_t weekdayIndex, uint16_t userIndex,
				    EmberAfPluginDoorLockWeekDaySchedule &schedule);
	DlStatus SetWeekDaySchedule(uint8_t weekdayIndex, uint16_t userIndex, DlScheduleStatus status,
				    DaysMaskMap daysMask, uint8_t startHour, uint8_t startMinute, uint8_t endHour,
				    uint8_t endMinute);
	DlStatus GetYearDaySchedule(uint8_t yearDayIndex, uint16_t userIndex,
				    EmberAfPluginDoorLockYearDaySchedule &schedule);
	DlStatus SetYearDaySchedule(uint8_t yearDayIndex, uint16_t userIndex, DlScheduleStatus status,
				    uint32_t localStartTime, uint32_t localEndTime);
	DlStatus GetHolidaySchedule(uint8_t holidayIndex, EmberAfPluginDoorLockHolidaySchedule &schedule);
	DlStatus SetHolidaySchedule(uint8_t holidayIndex, DlScheduleStatus status, uint32_t localStartTime,
				    uint32_t localEndTime, OperatingModeEnum operatingMode);
#endif /* CONFIG_LOCK_SCHEDULES */

	bool ValidatePIN(const Optional<chip::ByteSpan> &pinCode, OperationErrorEnum &err);

	void Lock(OperationSource source);
	void Unlock(OperationSource source);

	void SetRequirePIN(bool require);
	bool GetRequirePIN();

private:
	using AccessMgr = AccessManager<DoorLockData::PIN | DoorLockData::ALIRO_ISSUER | DoorLockData::ALIRO_EVICTABLE |
					DoorLockData::ALIRO_NON_EVICTABLE>;
	friend class AppTask;

	void SetState(State state, OperationSource source);

	static void ActuatorTimerEventHandler(k_timer *timer);
	static void ActuatorAppEventHandler(const BoltLockManagerEvent &event);
	friend BoltLockManager &BoltLockMgr();

	State mState = State::kLockingCompleted;
	StateChangeCallback mStateChangeCallback = nullptr;
	OperationSource mActuatorOperationSource = OperationSource::kButton;
	k_timer mActuatorTimer = {};

	static BoltLockManager sLock;
};

inline BoltLockManager &BoltLockMgr()
{
	return BoltLockManager::sLock;
}

struct BoltLockManagerEvent {
	BoltLockManager *manager;
};
```
